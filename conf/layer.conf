## conf/layer.conf
```bitbake
# We have a conf and classes directory, add to BBPATH
BBPATH .= ":${LAYERDIR}"

# We have a packages directory, add to BBFILES
BBFILES += "${LAYERDIR}/recipes-*/*/*.bb \
            ${LAYERDIR}/recipes-*/*/*.bbappend"

BBFILE_COLLECTIONS += "maaxboard-layer"
BBFILE_PATTERN_maaxboard-layer := "^${LAYERDIR}/"
BBFILE_PRIORITY_maaxboard-layer = "5"
LAYERSERIES_COMPAT_maaxboard-layer = "zeus"
```
